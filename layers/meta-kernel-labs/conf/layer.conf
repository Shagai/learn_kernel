## layers/meta-kernel-labs/conf/layer.conf
```bitbake
BBPATH .= ":${LAYERDIR}"
BBFILES += "${LAYERDIR}/recipes-*/*/*.bb ${LAYERDIR}/recipes-*/*/*.bbappend"

BBFILE_COLLECTIONS += "kernel_labs"
BBFILE_PATTERN_kernel_labs = "^${LAYERDIR}/"
BBFILE_PRIORITY_kernel_labs = "7"

LAYERSERIES_COMPAT_kernel_labs = "kirkstone scarthgap styhead"
```
